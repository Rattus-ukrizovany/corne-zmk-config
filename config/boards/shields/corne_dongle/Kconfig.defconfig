## config/boards/shields/corne_dongle/Kconfig.defconfig
```kconfig
# Copyright (c) 2020 The ZMK Contributors
# SPDX-License-Identifier: MIT

if SHIELD_CORNE_DONGLE

config ZMK_KEYBOARD_NAME
	default "Corne Dongle"

config ZMK_SPLIT_ROLE_CENTRAL
	default y

endif
```

## config/boards/shields/corne_dongle/Kconfig.shield
```kconfig
# Copyright (c) 2020 The ZMK Contributors
# SPDX-License-Identifier: MIT

config SHIELD_CORNE_DONGLE
	def_bool $(shields_list_contains,corne_dongle)
	select ZMK_SPLIT
	select ZMK_SPLIT_ROLE_CENTRAL
	select I2C
	select ZMK_DISPLAY
```

## config/dts/bindings/display/sinowealth,sh1106-i2c.yaml
```yaml
# Copyright (c) 2023 mctechnology17
# SPDX-License-Identifier: Apache-2.0

description: Sinowealth SH1106 display controller (I2C)

compatible: "sinowealth,sh1106"

include: [i2c-device.yaml]

properties:
  width:
    type: int
    required: true
    description: Width in pixels

  height:
    type: int  
    required: true
    description: Height in pixels

  segment-offset:
    type: int
    description: Segment offset

  page-offset:
    type: int
    description: Page offset

  display-offset:
    type: int
    description: Display offset

  multiplex-ratio:
    type: int
    description: Multiplex ratio

  segment-remap:
    type: boolean
    description: Enable segment remapping

  com-invdir:
    type: boolean
    description: Enable COM output scan direction inversion

  com-sequential:
    type: boolean
    description: Enable sequential COM pin configuration

  prechargep:
    type: int
    description: Pre-charge period setting

  vcomh:
    type: int
    description: VCOMH deselect level setting

  inversion-on:
    type: boolean
    description: Enable display inversion
```

## config/dts/bindings/display/solomon,ssd1306fb-i2c.yaml
```yaml
# Copyright (c) 2018, Phytec Messtechnik GmbH
# SPDX-License-Identifier: Apache-2.0

description: Solomon SSD1306 display controller (I2C)

compatible: "solomon,ssd1306fb"

include: [i2c-device.yaml]

properties:
  width:
    type: int
    required: true
    description: Width in pixels

  height:
    type: int  
    required: true
    description: Height in pixels

  segment-offset:
    type: int
    description: Segment offset

  page-offset:
    type: int
    description: Page offset

  display-offset:
    type: int
    description: Display offset

  multiplex-ratio:
    type: int
    description: Multiplex ratio

  segment-remap:
    type: boolean
    description: Enable segment remapping

  com-invdir:
    type: boolean
    description: Enable COM output scan direction inversion

  com-sequential:
    type: boolean
    description: Enable sequential COM pin configuration

  prechargep:
    type: int
    description: Pre-charge period setting

  vcomh:
    type: int
    description: VCOMH deselect level setting
```

## config/west.yml
```yaml
manifest:
  remotes:
    - name: zmkfirmware
      url-base: https://github.com/zmkfirmware
    - name: englmaxi
      url-base: https://github.com/englmaxi
    - name: mctechnology17
      url-base: https://github.com/mctechnology17
  projects:
    - name: zmk
      remote: zmkfirmware
      revision: main
      import: app/west.yml
    - name: zmk-dongle-display
      remote: englmaxi
      revision: main
    - name: zmk-oled-adapter
      remote: mctechnology17
      revision: main
  self:
    path: config
```
